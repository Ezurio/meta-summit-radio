## meta-summit-radio-pre-3.4/conf/layer.conf
```bitbake
# We have a conf and classes directory, add to BBPATH
BBPATH .= ":${LAYERDIR}"

# We have recipes-* directories, add to BBFILES
BBFILES += "${LAYERDIR}/recipes-*/*/*.bb \
	${LAYERDIR}/recipes-*/*/*.bbappend"

BBFILE_COLLECTIONS += "summit-radio-pre-3.4"
BBFILE_PATTERN_summit-radio-pre-3.4 = "^${LAYERDIR}/"
BBFILE_PRIORITY_summit-radio-pre-3.4 = "8"

RFPROS_FILESHARE_AUTH ?= ""

PREMIRRORS_prepend = "\
	https://github.com/Ezurio/.*/releases/download/.*/.*     file://${TOPDIR}/../release \n\
	"

LAYERSERIES_COMPAT_summit-radio-pre-3.4 = "sumo thud warrior zeus dunfell gatesgarth hardknott"
```

## meta-summit-radio/conf/layer.conf
```bitbake
# We have a conf and classes directory, add to BBPATH
BBPATH .= ":${LAYERDIR}"

# We have recipes-* directories, add to BBFILES
BBFILES += "${LAYERDIR}/recipes-*/*/*.bb \
	${LAYERDIR}/recipes-*/*/*.bbappend"

BBFILE_COLLECTIONS += "summit-radio"
BBFILE_PATTERN_summit-radio = "^${LAYERDIR}/"
BBFILE_PRIORITY_summit-radio = "8"

RFPROS_FILESHARE_AUTH ?= ""

SUMMIT_UNPACKDIR = "${@ d.getVar('UNPACKDIR') if d.getVar('UNPACKDIR') else d.getVar('WORKDIR') }"
SUMMIT_GIT_UNPACKDIR = "${@ d.getVar('BB_GIT_DEFAULT_DESTSUFFIX') if d.getVar('BB_GIT_DEFAULT_DESTSUFFIX') else d.getVar('WORKDIR') + '/git' }"

PREMIRRORS:prepend = "\
	https://github.com/Ezurio/.*/releases/download/.*/.*     file://${TOPDIR}/../release \n\
	"
```
